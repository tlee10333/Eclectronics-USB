## rpi-firmware/modules/pico_usbip_host/Kconfig
```kconfig
# SPDX-License-Identifier: Apache-2.0

config ZEPHYR_PICO_USBIP_HOST_MODULE
	bool
	default y

menuconfig UHC_RP2350_PIO_USB
	bool "RP2350 PIO USB host controller (Pico-PIO-USB)"
	default y
	depends on DT_HAS_RASPBERRYPI_RP2350_PIO_USB_UHC_ENABLED
	select PICOSDK_USE_PIO
	select PICOSDK_USE_DMA
	select PICOSDK_USE_GPIO
	select PICOSDK_USE_TIMER
	help
	  USB host using PIO (Pico-PIO-USB) for Raspberry Pi RP2040/RP2350.

if UHC_RP2350_PIO_USB

module = UHC_RP2350_PIO_USB
module-str = uhc_rp2350_pio_usb
source "subsys/logging/Kconfig.template.log_config"

endif # UHC_RP2350_PIO_USB

menuconfig UHC_RP2_NATIVE_USB
	bool "RP2 native USB host controller (TinyUSB/Pico SDK)"
	default n
	depends on DT_HAS_RASPBERRYPI_RP2_USB_UHC_ENABLED
	select PICOSDK_USE_GPIO
	select PICOSDK_USE_TIMER
	help
	  Experimental USB host controller using RP2040/RP2350 native USB
	  hardware via TinyUSB APIs from Pico SDK.
	  Keep UHC_RP2350_PIO_USB disabled when using this backend.

if UHC_RP2_NATIVE_USB

module = UHC_RP2_NATIVE_USB
module-str = uhc_rp2_native_usb
source "subsys/logging/Kconfig.template.log_config"

endif # UHC_RP2_NATIVE_USB
```

## rpi-firmware/modules/pico_usbip_host/dts/bindings/usb/raspberrypi,rp2-native-usb-uhc.yaml
```yaml
description: RP2 native USB host controller (TinyUSB/Pico SDK bridge)

compatible: "raspberrypi,rp2-usb-uhc"

include: base.yaml

properties: {}
```

## rpi-firmware/modules/pico_usbip_host/dts/bindings/usb/raspberrypi,rp2350-pio-usb-uhc.yaml
```yaml
# SPDX-License-Identifier: Apache-2.0

description: |
  Raspberry Pi RP2350/RP2040 USB host controller implemented with PIO (Pico-PIO-USB).

compatible: "raspberrypi,rp2350-pio-usb-uhc"

properties:
  dp-gpios:
    type: phandle-array
    required: true
    description: D+ GPIO (D- must be the adjacent pin per Pico-PIO-USB pinout).

  pio-tx-instance:
    type: int
    default: 0
    description: PIO block index for USB transmit.

  pio-rx-instance:
    type: int
    default: 0
    description: PIO block index for USB receive.

  dma-tx-channel:
    type: int
    default: 0
    description: DMA channel for USB transmit.

  sm-tx:
    type: int
    default: 0

  sm-rx:
    type: int
    default: 1

  sm-eop:
    type: int
    default: 2

  pinout-dpdm:
    type: boolean
    description: If true, DM = DP+1 (PIO_USB_PINOUT_DPDM).
```
